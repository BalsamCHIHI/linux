## drivers/net/wireless/ath/ath12k/Kconfig
```kconfig
# SPDX-License-Identifier: BSD-3-Clause-Clear
config ATH12K
	tristate "Qualcomm Technologies Wi-Fi 7 support (ath12k)"
	depends on MAC80211 && HAS_DMA && PCI
	select CRYPTO_MICHAEL_MIC
	select QCOM_QMI_HELPERS
	select MHI_BUS
	select QRTR
	select QRTR_MHI
	select PCI_PWRCTL_PWRSEQ if HAVE_PWRCTL
	help
	  Enable support for Qualcomm Technologies Wi-Fi 7 (IEEE
	  802.11be) family of chipsets, for example WCN7850 and
	  QCN9274.

	  If you choose to build a module, it'll be called ath12k.

config ATH12K_DEBUG
	bool "ath12k debugging"
	depends on ATH12K
	help
	  Enable debug support, for example debug messages which must
	  be enabled separately using the debug_mask module parameter.

	  If unsure, say Y to make it easier to debug problems. But if
	  you want optimal performance choose N.

config ATH12K_DEBUGFS
	bool "QTI ath12k debugfs support"
	depends on ATH12K && MAC80211_DEBUGFS
	help
	  Enable ath12k debugfs support

	  If unsure, say Y to make it easier to debug problems. But if
	  you want optimal performance choose N.

config ATH12K_TRACING
	bool "ath12k tracing support"
	depends on ATH12K && EVENT_TRACING
	help
	  Enable ath12k tracing infrastructure.

	  If unsure, say Y to make it easier to debug problems. But if
	  you want optimal performance choose N.

config ATH12K_COREDUMP
	bool "ath12k coredump"
	depends on ATH12K
	select WANT_DEV_COREDUMP
	help
	  Enable ath12k coredump collection

	  If unsure, say Y to make it easier to debug problems. But if
	  dump collection not required choose N.

choice
	prompt "Memory profile"
	depends on ATH12K
	default ATH12K_MEM_PROFILE_DEFAULT
	help
	  Allows to select the memory profile

	  By enabling this option, can choose between different memory
	  profiles, such as the default profile or a 512 MB profile.

config ATH12K_MEM_PROFILE_DEFAULT
	bool "ath12k default memory profile"
	depends on ATH12K
	help
	  Enables the default memory profile

	  This profile is recommended when memory is not constraint or
	  if unsure which profile to choose.

config ATH12K_MEM_PROFILE_512M
	bool "ath12k enable 512MB memory profile"
	depends on ATH12K
	help
	  Enables the 512MB memory profile

	  Selecting this option reduces memory allocation to the firmware,
	  decreases the number of transmit and receive descriptors, and
	  limits the monitor ring and the number of virtual devices
	  (vdevs).

endchoice
```
